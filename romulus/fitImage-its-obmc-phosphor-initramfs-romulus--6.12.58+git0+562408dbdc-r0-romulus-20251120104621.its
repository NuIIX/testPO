## romulus/fitImage-its-obmc-phosphor-initramfs-romulus--6.12.58+git0+562408dbdc-r0-romulus-20251120104621.its
```
/dts-v1/;

/ {
        description = "Kernel fitImage for Phosphor OpenBMC (Phosphor OpenBMC Project Reference Distro)/6.12.58+git/romulus";
        #address-cells = <1>;

        images {
                kernel-1 {
                        description = "Linux kernel";
                        data = /incbin/("linux.bin");
                        type = "kernel";
                        arch = "arm";
                        os = "linux";
                        compression = "none";
                        load = <0x80001000>;
                        entry = <0x80001000>;
                        hash-1 {
                                algo = "sha256";
                        };
                };
                fdt-aspeed-bmc-opp-romulus.dtb {
                        description = "Flattened Device Tree blob";
                        data = /incbin/("arch/arm/boot/dts/aspeed/aspeed-bmc-opp-romulus.dtb");
                        type = "flat_dt";
                        arch = "arm";
                        compression = "none";
                        
                        hash-1 {
                                algo = "sha256";
                        };
                };
                ramdisk-1 {
                        description = "obmc-phosphor-initramfs";
                        data = /incbin/("/data0/jenkins/workspace/ci-openbmc/distro/ubuntu/label/docker-builder/target/romulus/build/deploy/images/romulus/obmc-phosphor-initramfs-romulus.cpio.xz");
                        type = "ramdisk";
                        arch = "arm";
                        os = "linux";
                        compression = "none";
                        
                        
                        hash-1 {
                                algo = "sha256";
                        };
                };
	};

        configurations {
                default = "conf-aspeed-bmc-opp-romulus.dtb";
                conf-aspeed-bmc-opp-romulus.dtb {
                        description = "1 Linux kernel, FDT blob, ramdisk";
                        
                        kernel = "kernel-1";
                        fdt = "fdt-aspeed-bmc-opp-romulus.dtb";
                        ramdisk = "ramdisk-1";
                        
                        
                        hash-1 {
                                algo = "sha256";
                        };
                };
	};
};
```
